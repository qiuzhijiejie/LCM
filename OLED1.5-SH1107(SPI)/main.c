/********************金逸晨**************************
*****************1.5‘ 128-128 方屏     4PIN IIC OLED FOR AT89S52/STC12*************
*****AT89S52驱动**************************
***** P20----3  SCK   ,  P21----4  SDA   ,
***** BY:GU 
SH1107
//取模方式：列行式，低位在前，阴码
********************************************************/
#include "reg51.h"

#define set_0   0x01
#define set_1   0x02
#define set_2   0x04
#define set_3   0x08    
#define set_4   0x10
#define set_5   0x20
#define set_6   0x40
#define set_7   0x80

#define clr_0   0xFE
#define clr_1   0xFD
#define clr_2   0xFB
#define clr_3   0xF7    
#define clr_4   0xEF
#define clr_5   0xDF
#define clr_6   0xBF
#define clr_7   0x7F
/**********IIC引脚分配，连接oled屏，更具实际情况修改*********/

#define IIC_SCK_0  P1 &=clr_0        //P1_0      
#define IIC_SCK_1  P1|=set_0       
#define IIC_SDA_0  P1&=clr_1        //P1_1        
#define IIC_SDA_1  P1|=set_1


#define OLED_COLUMN_NUMBER 128
#define OLED_LINE_NUMBER 128
#define OLED_COLUMN_OFFSET 0
#define OLED_PAGE_NUMBER (OLED_LINE_NUMBER/8)
#define COMMAND_NUMBER 25
const unsigned char  *point;
unsigned char ACK=0;
const unsigned char  OLED_init_cmd[COMMAND_NUMBER]=			//SH1107
{
  
       0xAE,//关闭显示
	
       0xD5,//设置时钟分频因子,震荡频率
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       0xAF,//开启显示     
};
code unsigned char china_char[][32]=   //列行式，低位在前，阴码
{
{/*-- ID:0,字符:"Ｍ",ASCII编码:A3CD,对应字:宽x高=16x16,画布:宽W=16 高H=16,共32字节*/
0x00,0x00,0x04,0xfc,0x1c,0x70,0xe0,0x80,0x00,0x80,0xe0,0x10,0xfc,0xfc,0x04,0x00,
0x00,0x00,0x20,0x3f,0x20,0x00,0x01,0x07,0x1c,0x07,0x00,0x20,0x3f,0x3f,0x20,0x00,},

{/*-- ID:1,字符:"ａ",ASCII编码:A3E1,对应字:宽x高=16x16,画布:宽W=16 高H=16,共32字节*/
0x00,0x00,0x00,0x00,0x80,0xc0,0x40,0x40,0x40,0xc0,0x80,0x00,0x00,0x00,0x00,0x00,
0x00,0x00,0x00,0x00,0x0c,0x1e,0x12,0x12,0x12,0x1f,0x0f,0x10,0x10,0x00,0x00,0x00,},

{/*-- ID:2,字符:"ｄ",ASCII编码:A3E4,对应字:宽x高=16x16,画布:宽W=16 高H=16,共32字节*/
0x00,0x00,0x00,0x00,0x80,0xc0,0x40,0x40,0x44,0xfc,0xfc,0x00,0x00,0x00,0x00,0x00,
0x00,0x00,0x00,0x00,0x0f,0x1f,0x10,0x10,0x10,0x1f,0x0f,0x10,0x00,0x00,0x00,0x00,},

{/*-- ID:3,字符:"ｅ",ASCII编码:A3E5,对应字:宽x高=16x16,画布:宽W=16 高H=16,共32字节*/
0x00,0x00,0x00,0x00,0x80,0x80,0x40,0x40,0x40,0x40,0xc0,0x80,0x00,0x00,0x00,0x00,
0x00,0x00,0x00,0x00,0x0f,0x1f,0x12,0x12,0x12,0x12,0x1b,0x0b,0x00,0x00,0x00,0x00,},

{/*-- ID:4,字符:"ｉ",ASCII编码:A3E9,对应字:宽x高=16x16,画布:宽W=16 高H=16,共32字节*/
0x00,0x00,0x00,0x00,0x00,0x00,0x40,0xd8,0xd8,0x00,0x00,0x00,0x00,0x00,0x00,0x00,
0x00,0x00,0x00,0x00,0x00,0x00,0x10,0x1f,0x1f,0x10,0x00,0x00,0x00,0x00,0x00,0x00,},

{/*-- ID:5,字符:"ｎ",ASCII编码:A3EE,对应字:宽x高=16x16,画布:宽W=16 高H=16,共32字节*/
0x00,0x00,0x40,0x40,0x80,0xc0,0x40,0x40,0x40,0x40,0xc0,0x80,0x00,0x00,0x00,0x00,
0x00,0x00,0x00,0x10,0x1f,0x1f,0x10,0x00,0x00,0x10,0x1f,0x1f,0x10,0x00,0x00,0x00,},

{/*-- ID:6,字符:"Ｃ",ASCII编码:A3C3,对应字:宽x高=16x16,画布:宽W=16 高H=16,共32字节*/
0x00,0x00,0x00,0xe0,0xf0,0x18,0x0c,0x04,0x04,0x04,0x0c,0x18,0x18,0x00,0x00,0x00,
0x00,0x00,0x00,0x07,0x0f,0x18,0x30,0x20,0x20,0x20,0x30,0x10,0x08,0x00,0x00,0x00,},

{/*-- ID:7,字符:"ｈ",ASCII编码:A3E8,对应字:宽x高=16x16,画布:宽W=16 高H=16,共32字节*/
0x00,0x00,0x00,0x00,0x04,0xfc,0xfc,0x80,0x40,0x40,0xc0,0x80,0x00,0x00,0x00,0x00,
0x00,0x00,0x00,0x00,0x10,0x1f,0x1f,0x00,0x00,0x10,0x1f,0x1f,0x10,0x00,0x00,0x00},

{/*-- ID:8,字符:"ｉ",ASCII编码:A3E9,对应字:宽x高=16x16,画布:宽W=16 高H=16,共32字节*/
0x00,0x00,0x00,0x00,0x00,0x00,0x40,0xd8,0xd8,0x00,0x00,0x00,0x00,0x00,0x00,0x00,
0x00,0x00,0x00,0x00,0x00,0x00,0x10,0x1f,0x1f,0x10,0x00,0x00,0x00,0x00,0x00,0x00,},

{/*-- ID:9,字符:"ｎ",ASCII编码:A3EE,对应字:宽x高=16x16,画布:宽W=16 高H=16,共32字节*/
0x00,0x00,0x40,0x40,0x80,0xc0,0x40,0x40,0x40,0x40,0xc0,0x80,0x00,0x00,0x00,0x00,
0x00,0x00,0x00,0x10,0x1f,0x1f,0x10,0x00,0x00,0x10,0x1f,0x1f,0x10,0x00,0x00,0x00,},

{/*-- ID:10,字符:"ａ",ASCII编码:A3E1,对应字:宽x高=16x16,画布:宽W=16 高H=16,共32字节*/
0x00,0x00,0x00,0x00,0x80,0xc0,0x40,0x40,0x40,0xc0,0x80,0x00,0x00,0x00,0x00,0x00,
0x00,0x00,0x00,0x00,0x0c,0x1e,0x12,0x12,0x12,0x1f,0x0f,0x10,0x10,0x00,0x00,0x00},

{/*-- ID:0,字符:"！",ASCII编码:A3A1,对应字:宽x高=16x16,画布:宽W=16 高H=16,共32字节*/
0x00,0x00,0x00,0x00,0x00,0x00,0x7c,0xfe,0xfe,0x7c,0x00,0x00,0x00,0x00,0x00,0x00,
0x00,0x00,0x00,0x00,0x00,0x00,0x10,0x3b,0x3b,0x10,0x00,0x00,0x00,0x00,0x00,0x00},

};
code unsigned char  picture_tab[]={
//图片显示，列行式，低位在前，阴码
0XFF,0XFF,0XFF,0XFF,0XFF,0XFF,0XFF,0XFF,0XFF,0XFF,0XFF,0XFF,0XFF,0XFF,0XFF,0XFF,
0XFF,0XFF,0XFF,0XFF,0XFF,0XFF,0XFF,0XFF,0XFF,0XFF,0XFF,0XFF,0XFF,0XFF,0XFF,0XFF,
0XFF,0XFF,0XFF,0XFF,0XFF,0XFF,0XFF,0XFF,0XFF,0XFF,0XFF,0XFF,0XFF,0XFF,0XFF,0XFF,
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0XFF,0XFF,0XFF,0XFF,0XFF,0XFF,0XFF,0XFF,0XFF,0XFF,0XFF,0XFF,0XFF,0XFF,0XFF,0XFF,
};
void delay_us(unsigned int _us_time)
{       
  unsigned char x=0;
  for(;_us_time>0;_us_time--)
  {
    x++;
  }
}
void delay_ms(unsigned int _ms_time)
  {
    unsigned int i,j;
    for(i=0;i<_ms_time;i++)
    {
    for(j=0;j<900;j++)
      {;}
    }
  }
/**************************IIC模块发送函数************************************************

 *************************************************************************/
//写入  最后将SDA拉高，以等待从设备产生应答
void IIC_write(unsigned char date)
{
	unsigned char i, temp;
	temp = date;
			
	for(i=0; i<8; i++)
	{	IIC_SCK_0;
		
                if ((temp&0x80)==0)
                  IIC_SDA_0;
                else IIC_SDA_1;
		temp = temp << 1;
						  //最少250ns延时
		IIC_SCK_1;
		
	}
	IIC_SCK_0;
	
	IIC_SDA_1;
	
	IIC_SCK_1;
	
	 ACK =0;
	IIC_SCK_0;
	

}
//启动信号
//SCL在高电平期间，SDA由高电平向低电平的变化定义为启动信号
void IIC_start()
{
	IIC_SDA_1;
	
	IIC_SCK_1;
					   //所有操作结束释放SCL	
	IIC_SDA_0;
	
	IIC_SCK_0;
	
        IIC_write(0x78);
        
}

//停止信号
//SCL在高电平期间，SDA由低电平向高电平的变化定义为停止信号
void IIC_stop()
{
	IIC_SDA_0;
	
	IIC_SCK_1;
	
	IIC_SDA_1;
	
}

void OLED_send_cmd(unsigned char o_command)
  {
    
    IIC_start();
    IIC_write(0x00); 
    IIC_write(o_command);
    IIC_stop();
    
  }
void OLED_send_data(unsigned char o_data)
  { 
    IIC_start();
    IIC_write(0x40);
    IIC_write(o_data);
    IIC_stop();
   }
void Column_set(unsigned char column)
  {
	column+=OLED_COLUMN_OFFSET;
    OLED_send_cmd(0x10|(column>>4));    //???????
    OLED_send_cmd(0x00|(column&0x0f));   //???????  
    	 
  }
void Page_set(unsigned char page)
  {
    OLED_send_cmd(0xb0+page);
  }
void OLED_clear(void)
  {
    unsigned char page,column;
    for(page=0;page<OLED_PAGE_NUMBER;page++)             //page loop
      { 
          Page_set(page);
          Column_set(0);	  
          for(column=0;column<OLED_COLUMN_NUMBER;column++)	//column loop
            {
              OLED_send_data(0x00);
            }
      }
  }
  
void OLED_full(unsigned char oddData, unsigned char evenData)
{
    unsigned char page, column;
    for(page = 0; page < OLED_PAGE_NUMBER; page++)   // page loop
    { 
        Page_set(page);
        Column_set(0);	  
        for(column = 0; column < OLED_COLUMN_NUMBER; column++) // column loop
        {
            if(column % 2 == 0)      // 偶数列
                OLED_send_data(evenData);
            else                     // 奇数列
                OLED_send_data(oddData);
        }
    }
}
  
void OLED_init(void)
  {
    unsigned char i;
	
    for(i=0;i<COMMAND_NUMBER;i++)
      {
        OLED_send_cmd(OLED_init_cmd[i]);
      }
  }

void Picture_display(const unsigned char *ptr_pic)
  {
    unsigned char page,column;
    for(page=0;page<(OLED_PAGE_NUMBER);page++)        //page loop
      { 
	Page_set(page);
	Column_set(0);	  
	for(column=0;column<OLED_COLUMN_NUMBER;column++)	//column loop
          {
            OLED_send_data(*ptr_pic++);
          }
      }
  }
void Picture_ReverseDisplay(const unsigned char *ptr_pic)
{
    unsigned char page,column,dis_data;
    for(page=0;page<(OLED_PAGE_NUMBER);page++)        //page loop
      { 
		Page_set(page);
		Column_set(0);	  
		for(column=0;column<OLED_COLUMN_NUMBER;column++)	//column loop
          {
            dis_data=*ptr_pic++;
            
			 
				 dis_data=~dis_data;
            OLED_send_data(dis_data);
          }
      }
  }
void display_char16_16(char x_page,char y_column,const unsigned char *char16_16)
{
	unsigned char column,dis_data; 
		Page_set(x_page);
		Column_set(y_column);	  
		for(column=0;column<16;column++)	//column loop
          {
            dis_data=*char16_16++;
            OLED_send_data(dis_data);
          }
		  Page_set(x_page+1);
		Column_set(y_column);	  
		for(column=0;column<16;column++)	//column loop
          {
            dis_data=*char16_16++;
            OLED_send_data(dis_data);
          }
}

void IO_init(void)
{
  P2|=0xFF;                         //PC  06,07，03,04,07输出模式
  

}

unsigned char y_pos[] = {16, 32, 48, 60, 78, 84, 100, 116};
unsigned char i;
int main()
{ 
 
  IO_init();
  
  OLED_init();
//  OLED_full();
  delay_ms(100);
  OLED_clear();
  while(1)
  {
//    point= &picture_tab[0];
//    Picture_display(point);
//    delay_ms(500);
//    point= &picture_tab[0];
//    Picture_ReverseDisplay(point);
//    delay_ms(500);
//    OLED_clear();
    display_char16_16(0,0,china_char[0]);
    delay_ms(500);
    display_char16_16(2,16,china_char[1]);
    delay_ms(500);
    display_char16_16(4,32,china_char[2]);
    delay_ms(500);
    display_char16_16(6,48,china_char[3]);
    delay_ms(500);
    display_char16_16(8,64,china_char[4]);
    delay_ms(500);
    display_char16_16(10,80,china_char[5]);
    delay_ms(500);
	  
    display_char16_16(14,16,china_char[6]);
    delay_ms(500);
    display_char16_16(14,32,china_char[7]);
    delay_ms(500);	 
	display_char16_16(14,48,china_char[8]);
    delay_ms(500);
    display_char16_16(14,64,china_char[9]);
    delay_ms(500);
    display_char16_16(14,80,china_char[10]);
    delay_ms(500);
    display_char16_16(14,96,china_char[11]);
    delay_ms(500); 

//for(i = 0; i < 11; i++)
//{
//    display_char16_16(0, y_pos[i], china_char[i]);
//    delay_ms(500);
//}

OLED_full(0xFF, 0x00);  
delay_ms(200);
OLED_full(0x00, 0xff);  
 delay_ms(200);
OLED_full(0xAA, 0x55);  
delay_ms(200);
OLED_full(0x55, 0xaa);  
delay_ms(200);
OLED_full(0xAA, 0xaa); 
delay_ms(200);
OLED_full(0x55, 0x55);
delay_ms(200);
OLED_full(0xff, 0xff); 

  }
}
