/********************金逸晨**************************
*****************2.42 4PIN IIC OLED FOR Arduino*************
*****3----3SCK,   4----4SDA,
*****BY:GU
SSD1309    
********************************************************/
#define OLED_COLUMN_NUMBER 128
#define OLED_LINE_NUMBER 64
#define OLED_PAGE_NUMBER (OLED_LINE_NUMBER/8)
#define OLED_COLUMN_OFFSET 0
#define OLED_LINE_OFFSET 0
#define OLED_CMD_NUMBER 25
#define IIC_SCK_0  digitalWrite(3,LOW)
#define IIC_SCK_1  digitalWrite(3,HIGH)
#define IIC_SDA_0  digitalWrite(4,LOW)
#define IIC_SDA_1  digitalWrite(4,HIGH)


const unsigned char  *point;

const unsigned char  OLED_init_cmd[OLED_CMD_NUMBER]=
{
  
     0xAE,//关闭显示
 
       0xD5,//设置时钟分频因子,震荡频率
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       0xAF,//开启显示   
};

const unsigned char  picture_tab[]={
//图片显示，列行式，低位在前，阴码
0xFF,0x01,0x01,0x01,0x01,0x01,0x01,0x01,0x01,0x01,0x01,0x01,0x01,0x01,0x01,0x01,
0x01,0x01,0x01,0x01,0x01,0x01,0x01,0x01,0x01,0x01,0x01,0x01,0x01,0x01,0x01,0x01,
0x01,0x01,0x01,0x01,0x01,0x01,0x01,0x01,0x01,0x01,0x01,0x01,0x01,0x01,0x01,0x01,
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0x80,0x80,0x80,0x80,0x80,0x80,0x80,0x80,0x80,0x80,0x80,0x80,0x80,0x80,0x80,0xFF

};
void delay_us(unsigned char time_us)
{
  unsigned char temp=0;
  while (time_us--)
  {
    temp++;
    temp++;
    temp++;
    temp++;
    temp++;
  }
}

/**************************IIC模块发送函数************************************************

 *************************************************************************/
//写入  最后将SDA拉高，以等待从设备产生应答
void IIC_write(unsigned char date)
{
  unsigned char i, temp;
  temp = date;
      
  for(i=0; i<8; i++)
  { IIC_SCK_0;
    
                if ((temp&0x80)==0)
                  IIC_SDA_0;
                else IIC_SDA_1;
    temp = temp << 1;
              //最少250ns延时
    IIC_SCK_1;
    
  }
  IIC_SCK_0;
  
  IIC_SDA_1;
  
  IIC_SCK_1;
  
  IIC_SCK_0;
  

}
//启动信号
//SCL在高电平期间，SDA由高电平向低电平的变化定义为启动信号
void IIC_start()
{
  IIC_SDA_1;
  
  IIC_SCK_1;
             //所有操作结束释放SCL  
  IIC_SDA_0;
  
  IIC_SCK_0;
  
        IIC_write(0x78);
        
}

//停止信号
//SCL在高电平期间，SDA由低电平向高电平的变化定义为停止信号
void IIC_stop()
{
  IIC_SDA_0;
  
  IIC_SCK_1;
  
  IIC_SDA_1;
  
}

void OLED_send_cmd(unsigned char o_command)
  {
    
    IIC_start();
    IIC_write(0x00); 
    IIC_write(o_command);
    IIC_stop();
    
  }
void OLED_send_data(unsigned char o_data)
  { 
    IIC_start();
    IIC_write(0x40);
    IIC_write(o_data);
    IIC_stop();
   }
void Column_set(unsigned char column)
  {
    column+=OLED_COLUMN_OFFSET;
    OLED_send_cmd(0x10|(column>>4));    //设置列地址高位
    OLED_send_cmd(0x00|(column&0x0f));   //设置列地址低位  
       
  }
void Page_set(unsigned char page)
  {
    OLED_send_cmd(0xb0+page);
  }
void OLED_clear(void)
  {
    unsigned char page,column;
    for(page=0;page<OLED_PAGE_NUMBER;page++)             //page loop
      { 
          Page_set(page);
          Column_set(0);    
          for(column=0;column<OLED_COLUMN_NUMBER;column++)  //column loop
            {
              OLED_send_data(0x00);
            }
      }
  }
void OLED_full(void)
  {
    unsigned char page,column;
    for(page=0;page<OLED_PAGE_NUMBER;page++)             //page loop
      { 
        Page_set(page);
        Column_set(0);    
  for(column=0;column<OLED_COLUMN_NUMBER;column++)  //column loop
          {
            OLED_send_data(0xff);
          }
      }
  }
void OLED_init(void)
  {
    unsigned char i;
    for(i=0;i<25;i++)
      {
        OLED_send_cmd(OLED_init_cmd[i]);
      }
  }

void Picture_display(const unsigned char *ptr_pic)
  {
    unsigned char page,column;
    for(page=0;page<OLED_PAGE_NUMBER;page++)        //page loop
      { 
  Page_set(page);
  Column_set(0);    
  for(column=0;column<OLED_COLUMN_NUMBER;column++)  //column loop
          {
            OLED_send_data(*ptr_pic++);
          }
      }
  }
void Picture_ReverseDisplay(const unsigned char *ptr_pic)
{
    unsigned char page,column,data;
    for(page=0;page<OLED_PAGE_NUMBER;page++)        //page loop
      { 
  Page_set(page);
  Column_set(0);    
  for(column=0;column<OLED_COLUMN_NUMBER;column++)  //column loop
          {
            data=*ptr_pic++;
            data=~data;
            OLED_send_data(data);
          }
      }
  }
void  IO_init(void )
{
  pinMode(3, OUTPUT); //设置数字脚为输出
  pinMode(4, OUTPUT); //设置数字脚为输出
  digitalWrite(3, HIGH);
  digitalWrite(4, HIGH);
  
}

void  setup() 
{
  point= &picture_tab[0];
   IO_init();
  OLED_init();
  OLED_clear();

}

void  loop() 
{

    Picture_display(point);
    delay(1000);
    
    Picture_ReverseDisplay(point);   
    
  delay(1000);
    


}
