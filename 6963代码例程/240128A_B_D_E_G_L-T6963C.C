//----------------------------------------------------------------------
//
 Module    : 240128
// Lanuage   : C51 Code
// Date      
: 2009-06-18
// Drive IC  : T6963	
(横向取模,字节正序 )
// INTERFACE : 8080_8bit
// MCU 		 : AT89C52
// VDD: 5V                 

//***************************************************************************    
   
   

#include <REG52.H>   
#include <INTRINS.H>    
#include <STDIO.H>     
#include <MATH.H>    
#include <ABSACC.H>    


#define uchar  unsigned char
#define uint  unsigned int
#define DataBus		
P1
#define Graphic		1
#define	Character 	0
       
   

/********************DEFINE IO********************/    


sbit CD =P3^3;    	// 	COMMAND/DATA
sbit RESET =P3^4; 	//	RESET

sbit FS =P3^5; 		//  0：8*8   1 6*8     

sbit _WR =P3^0; 	//	WRITE    
sbit _RD =P3^1;		//	READ
sbit CS	=P3^2;		// CHIP ENABLE SIGNAL


unsigned char code BMP0[];   
unsigned char code BMP1[];      
unsigned char code Chinese_character[];



void Locatexy(uchar xa,uchar ya,uchar mode);
void CheckBusy_S0S1();
void CheckBusy_S2();
void CheckBusy_S3();

void WriteCommand( uchar dat1,uchar dat2,uchar command,uchar parameters_num );
void WriteData( uchar DataByte );

void LcmClear( void ); 
void Display_Str(uchar x,uchar y,uchar *ascll);
void Display_16_16(uchar x,uchar y,uchar  code 
*Chinese_character,uchar character_code);
void DisplayDots( uchar DotByte,uchar DotByte1 );
void LcmInit( void );

void DisplayBMP(uchar x,uchar y,uchar W,uchar H,  uchar  code *puts );
void ReverseDisplayBMP(uchar x,uchar y,uchar W,uchar H,  uchar  code *puts );
void Delay(uint MS); 
void TestAscll(void); 

    
/********************************************************/   
  // LOCATE X AND Y OF LCM
/********************************************************/   
void Locatexy(uchar xa,uchar ya,uchar mode)   
{  uint a=0;
	if(mode)				//Graphic mode   x=0-29  y=0-127    START ADDRESS ：0800
		{
			a=ya*30+xa;	
			WriteCommand((uchar)a,(uchar)(a>>8)+0x08,0x24,2);
		}

	else					//Character mode   x=0-29  y=0-15    START ADDRESS ：0000
		{
			a=ya*30+xa;	
			WriteCommand((uchar)(a),(uchar)(a>>8),0x24,2);
		}
}

/***************************/   
/*LCM READ AND WRITE BUSY CHECK                   
/***************************/ 

void CheckBusy_S0S1()
{uchar b;
	 do	
	{DataBus=0xff;
	 CD=1;
	 _RD=0;
	 b=DataBus;
	  _RD=1;	
	 }
	 while(b&0x03!=0x03);
		
 }

/***************************/   
/*DATA AUTO READ BUSY CHECK                    
/***************************/ 

void CheckBusy_S2()
{uchar b;
	 do	
	{DataBus=0xff;
	 CD=1;
	 _RD=0;
	 b=DataBus;
	 _RD=1;	
	 }
	 while(b&0x03==0);	 	
}


/***************************/   
/*DATA AUTO WRITE BUSY CHECK                    
/***************************/ 

void CheckBusy_S3()
{uchar b;
	 do	
	{DataBus=0xff;
	 CD=1;
	 _RD=0;
	 b=DataBus;
	 _RD=1;	
	 }
	 while(b&0x08!=0x08);
}


   
/***************************/   
/*WRITE COMMAND             */   
/***************************/   
void WriteCommand( uchar dat1,uchar dat2,uchar command,uchar parameters_num )   
{   
  if((parameters_num==1)|(parameters_num==2))
  	{CheckBusy_S0S1();	
 	 WriteData(dat1);
	}	
  if(parameters_num==2)
  	{CheckBusy_S0S1();	
 	 WriteData(dat2);
	}

	CheckBusy_S3();
 	CD = 1;   
 	DataBus = command; 
 	_WR = 0; 
	_nop_();     
 	_WR  = 1;      
}   

   
/***************************/   
/*WRITE DATA                 */   
/***************************/   
void WriteData( uchar DataByte )   
{    
	 CD = 0;   
	 DataBus = DataByte;   
	 _WR = 0;  
	_nop_();    
	 _WR  = 1;   
}   
   
void LcmClear( void )   
{   uint a;
	Locatexy(0,0,Character);
	WriteCommand(0,0,0xb0,0 ); 
	for(a=0;a<8192;a++)
	{
		WriteData( 0 ); 
	}   
	WriteCommand(0,0,0xb2,0 );
}   

void Display_Str(uchar x,uchar y,uchar *ascll)
{
	Locatexy(x,y,Character);
	while(*ascll>0)
	{
		WriteCommand(*ascll-0x20,0,0xc0,1 ); 
		ascll++;
	} 
}


void Display_16_16(uchar x,uchar y,uchar  code *Chinese_character,uchar character_code)
{	uchar k,j;    uint	num=0;
 	num=character_code*0x20;
	Locatexy(x,y,Graphic);
	for(j=0;j<16;j++)
		{ for(k=0;k<2;k++)
			{
				WriteCommand(*(Chinese_character+num),0,0xc0,1 ); 
				num++;
			} 
			y+=1;
			Locatexy(x,y,Graphic);
		}
}

void DisplayDots( uchar DotByte,uchar DotByte1 )   
{ 	uchar k,j;  
	Locatexy(0,0,Graphic);  
 	WriteCommand(0,0,0xb0,0 ); 
	 for(j=0;j<64;j++)   
	 {   
	  for(k=0;k<30;k++)   
		{
			WriteData(DotByte);
		} 
	  for(k=0;k<30;k++)   
		{
			WriteData(DotByte1);
		} 
  	}  
  	WriteCommand(0,0,0xb2,0 ); 
}  

     
void DisplayBMP(uchar x,uchar y,uchar W,uchar H,  uchar code *puts )   
{  	uchar k,j;
	Locatexy(x,y,Graphic); 
      
	for(j=0;j<H;j++)
		{	WriteCommand(0,0,0xb0,0 ); 
		 	for(k=0;k<W/8;k++)
			{
				WriteData(*puts++);
			} 
		WriteCommand(0,0,0xb2,0 ); 
			y+=1;
			Locatexy(x,y,Graphic);
		}  
}   
     
void ReverseDisplayBMP(uchar x,uchar y,uchar W,uchar H,  uchar code *puts )   
{  	uchar k,j;
	Locatexy(x,y,Graphic); 
      
	for(j=0;j<H;j++)
		{	WriteCommand(0,0,0xb0,0 ); 
		 	for(k=0;k<W/8;k++)
			{
				WriteData(~(*puts));
				puts++;
			} 
		WriteCommand(0,0,0xb2,0 ); 
			y+=1;
			Locatexy(x,y,Graphic);
		}  
}  
   
void Delay(uint MS)   
{   
 unsigned char us,usn;   
 while(MS!=0)   
 {   
  usn = 2; //for 12M    
  while(usn!=0)   
  {   
   us=0xf6;   
   while (us!=0){us--;};   
   usn--;   
  }   
  MS--;   
 }  
}   


void LcmInit( void )   
{  
 	RESET=0;
 	Delay(50);
	RESET=1;
 	Delay(50);
	WriteCommand(0,0,0x40,2 );   
	WriteCommand(30,0,0x41,2 );    
	WriteCommand(0,0x08,0x42,2 );   
	WriteCommand(30,0,0x43,2 );  
	WriteCommand(0,0,0xa7,0);
	WriteCommand(0,0,0x80,0);
	WriteCommand(0,0,0x9c,0);   
}   

   
void Main( void )   
{
	CS=0;  
	FS=0; 
	LcmInit(); 
 while(1)  
{	 LcmClear(); 
	 Display_16_16(0,0,Chinese_character,0);		 //
	 Display_16_16(2,0,Chinese_character,1);
	 Display_16_16(4,0,Chinese_character,2);
	 Display_16_16(6,0,Chinese_character,3);
	 Display_16_16(8,0,Chinese_character,4);
	 Display_16_16(10,0,Chinese_character,5);
	 Display_16_16(12,0,Chinese_character,6);
	 Display_16_16(14,0,Chinese_character,7);
	 Display_16_16(16,0,Chinese_character,8);
	 Display_16_16(18,0,Chinese_character,9);
	 Display_16_16(20,0,Chinese_character,10);
	 Display_16_16(22,0,Chinese_character,11);
	 Display_16_16(24,0,Chinese_character,12);
	
 	Display_Str(0,3,"SHENZHEN YABIN  ELECTRONIC TEST PROGRAM");
 	Display_Str(7,5,"Welcome to use!");
	Display_Str(0,7,"X:COORDINATES:");
	Display_Str(0,9,"Y:COORDINATES:");

	Display_Str(0,15,"EXIT ");
	Delay(1500); 
  
   	LcmClear();
 /*
    DisplayDots(0x55,0xaa);
    Delay(500); 
    DisplayDots(0xaa,0x55);
    Delay(500);
  
    DisplayDots(0x55,0x55);
    Delay(500); 
    DisplayDots(0xaa,0xaa);
    Delay(500); 

    DisplayDots(0xff,0x00);
    Delay(500); 
    DisplayDots(0x00,0xff);
    Delay(500); 
	*/
    DisplayBMP(0,0,240,128,BMP0);   		   
    Delay(1500); 
    ReverseDisplayBMP(0,0,240,128,BMP0);   
    Delay(1500); 
 /*
    DisplayBMP(0,0,240,128,BMP1);   
    Delay(1500);    
    ReverseDisplayBMP(0,0,240,128,BMP1);   
    Delay(1500);     
  */
 }   
}   
  

unsigned char code Chinese_character[]=
{/*--  文字:  欢  --*/

/*--  宋体12;  此字体下对应的点阵为：宽x高=16x16   --*/

0x00,0x80,0x00,0x80,0xFC,0x80,0x05,0xFE,0x85,0x04,0x4A,0x48,0x28,0x40,0x10,0x40,

0x18,0x40,0x18,0x60,0x24,0xA0,0x24,0x90,0x41,0x18,0x86,0x0E,0x38,0x04,0x00,0x00,/*--  文字:  迎  --*/

/*--  宋体12;  此字体下对应的点阵为：宽x高=16x16   --*/

0x40,0x00,0x21,0x80,0x36,0x7C,0x24,0x44,0x04,0x44,0x04,0x44,0xE4,0x44,0x24,0x44,

0x25,0x44,0x26,0x54,0x24,0x48,0x20,0x40,0x20,0x40,0x50,0x00,0x8F,0xFE,0x00,0x00,/*--  文字:  使  --*/

/*--  宋体12;  此字体下对应的点阵为：宽x高=16x16   --*/

0x08,0x40,0x0C,0x40,0x1B,0xFE,0x10,0x40,0x37,0xFC,0x64,0x44,0xA4,0x44,0x27,0xFC,

0x24,0x44,0x22,0x40,0x21,0x80,0x20,0x80,0x21,0x70,0x22,0x1E,0x2C,0x04,0x00,0x00,/*--  文字:  用  --*/

/*--  宋体12;  此字体下对应的点阵为：宽x高=16x16   --*/
0x00,0x10,0x20,0x14,0x11,0xD2,0x00,0x12,0xFC,0x10,0x0B,0xFE,0x08,0x10,0x48,0x90,
0x28,0x90,0x12,0xD0,0x12,0x90,0x2A,0x90,0x2A,0x8A,0x4A,0xEA,0x87,0x06,0x02,0x02,

/*--  文字:  电  --*/
/*--  宋体12;  此字体下对应的点阵为：宽x高=16x16   --*/
0x01,0x00,0x01,0x00,0x01,0x00,0x3F,0xF8,0x21,0x08,0x21,0x08,0x21,0x08,0x3F,0xF8,
0x21,0x08,0x21,0x08,0x21,0x08,0x3F,0xF8,0x21,0x0A,0x01,0x02,0x01,0x02,0x00,0xFE,

/*--  文字:  子  --*/
/*--  宋体12;  此字体下对应的点阵为：宽x高=16x16   --*/
0x00,0x00,0x7F,0xF8,0x00,0x10,0x00,0x20,0x00,0x40,0x01,0x80,0x01,0x00,0xFF,0xFE,
0x01,0x00,0x01,0x00,0x01,0x00,0x01,0x00,0x01,0x00,0x01,0x00,0x05,0x00,0x02,0x00,/*--  文字:  图  --*/
/*--  宋体12;  此字体下对应的点阵为：宽x高=16x16   --*/
0x00,0x00,0x7F,0xFC,0x42,0x04,0x42,0x04,0x47,0xE4,0x4C,0x44,0x52,0x84,0x41,0x04,
0x46,0xC4,0x78,0x3C,0x43,0x04,0x40,0x84,0x46,0x04,0x41,0x84,0x7F,0xFC,0x40,0x04,

/*--  文字:  形  --*/
/*--  宋体12;  此字体下对应的点阵为：宽x高=16x16   --*/
0x00,0x00,0x7F,0x84,0x12,0x04,0x12,0x08,0x12,0x10,0x12,0x22,0x12,0x02,0xFF,0xC4,
0x12,0x08,0x12,0x10,0x12,0x22,0x12,0x02,0x22,0x04,0x22,0x08,0x42,0x10,0x82,0x60,/*--  文字:  点  --*/
/*--  宋体12;  此字体下对应的点阵为：宽x高=16x16   --*/
0x02,0x00,0x02,0x00,0x02,0x00,0x03,0xFC,0x02,0x00,0x02,0x00,0x3F,0xF0,0x20,0x10,
0x20,0x10,0x20,0x10,0x3F,0xF0,0x00,0x00,0x24,0x88,0x22,0x44,0x42,0x44,0x80,0x04,/*--  文字:  阵  --*/
/*--  宋体12;  此字体下对应的点阵为：宽x高=16x16   --*/
0x00,0x40,0x7C,0x40,0x44,0x40,0x4B,0xFE,0x48,0x80,0x50,0xA0,0x49,0x20,0x49,0xFC,
0x44,0x20,0x44,0x20,0x44,0x20,0x6B,0xFE,0x50,0x20,0x40,0x20,0x40,0x20,0x40,0x20,/*--  文字:  屏  --*/

/*--  宋体12;  此字体下对应的点阵为：宽x高=16x16   --*/

0x3F,0xFC,0x20,0x04,0x20,0x04,0x3F,0xFC,0x24,0x10,0x22,0x20,0x2F,0xFC,0x22,0x20,

0x22,0x20,0x3F,0xFE,0x22,0x20,0x22,0x20,0x44,0x20,0x44,0x20,0x88,0x20,0x10,0x20,


};


unsigned char code BMP0[]={


/*--  调入了一幅图像：d:\My Documents\My Pictures\240128.bmp  --*/
/*--  宽度x高度=240x128  --*/
0XFF,0XFF,0XFF,0XFF,0XFF,0XFF,0XFF,0XFF,0XFF,0XFF,0XFF,0XFF,0XFF,0XFF,0XFF,0XFF,
0XFF,0XFF,0XFF,0XFF,0XFF,0XFF,0XFF,0XFF,0XFF,0XFF,0XFF,0XFF,0XFF,0XFF,0XFF,0XFF,
0XFF,0XFF,0XFF,0XFF,0XFF,0XFF,0XFF,0XFF,0XFF,0XFF,0XFF,0XFF,0XFF,0XFF,0XFF,0XFF,
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0XFF,0XFF,0XFF,0XFF,0XFF,0XFF,0XFF,0XFF,0XFF,0XFF,0XFF,0XFF,0XFF,0XFF,0XFF,0XFF,
};
 
unsigned char code BMP1[]={ 
/*--  调入了一幅图像：d:\My Documents\My Pictures\240128.bmp  --*/
/*--  宽度x高度=240x128  --*/
0x00,0x00,0x00,0x00,0x00,0x00,0x00,0x00,0x00,0x00,0x00,0x00,0x00,0x00,0x00,0x00,
0x00,0x00,0x00,0x00,0x00,0x00,0x00,0x00,0x00,0x00,0x00,0x00,0x00,0x00,0x00,0x00,
0x00,0x00,0x00,0x00,0x00,0x00,0x00,0x00,0x00,0x00,0x00,0x00,0x00,0x00,0x00,0x00,
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0x00,0x00,0x00,0x00,0x00,0x00,0x00,0x00,0x00,0x00,0x00,0x00,0x00,0x00,0x00,0x00

};   
