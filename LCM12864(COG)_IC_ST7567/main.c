#include <reg51.H>
#include <intrins.h>

sbit lcd_rs=P1^2;    /*接口定义:lcd_rs就是LCD的rs*/
sbit lcd_sclk=P3^6;  /*接口定义:lcd_sclk就是LCD的sclk*/
sbit lcd_sid=P3^7;   /*接口定义:lcd_sid就是LCD的sid*/
sbit lcd_reset=P1^0; /*接口定义:lcd_reset就是LCD的reset*/
sbit lcd_cs1=P1^1;   /*接口定义:lcd_cs1就是LCD的cs1*/

#define uchar unsigned char 
#define uint unsigned int
#define ulong unsigned long


void lcd_address(uchar page,uchar column) ;


uchar code bmp1[];
uchar code bmp2[];
uchar code jiong1[]={/*--  文字:  囧  --*/
/*--  宋体12;  此字体下对应的点阵为：宽x高=16x16   --*/
0x00,0xFE,0x82,0x42,0xA2,0x9E,0x8A,0x82,0x86,0x8A,0xB2,0x62,0x02,0xFE,0x00,0x00,
0x00,0x7F,0x40,0x40,0x7F,0x40,0x40,0x40,0x40,0x40,0x7F,0x40,0x40,0x7F,0x00,0x00};

uchar code lei1[]={/*--  文字:  畾  --*/
/*--  宋体12;  此字体下对应的点阵为：宽x高=16x16   --*/
0x80,0x80,0x80,0xBF,0xA5,0xA5,0xA5,0x3F,0xA5,0xA5,0xA5,0xBF,0x80,0x80,0x80,0x00,
0x7F,0x24,0x24,0x3F,0x24,0x24,0x7F,0x00,0x7F,0x24,0x24,0x3F,0x24,0x24,0x7F,0x00};


/*写指令到LCD模块*/
void transfer_command_lcd(int data1)   
{
	char i;
	lcd_rs=0;
	for(i=0;i<8;i++)
   {
		lcd_sclk=0;
		if(data1&0x80) lcd_sid=1;
		else lcd_sid=0;
		lcd_sclk=1;
	 	data1=data1<<=1;
   }
}

/*写数据到LCD模块*/
void transfer_data_lcd(int data1)
{
	char i;
	lcd_rs=1;
	for(i=0;i<8;i++)
   {
		lcd_sclk=0;
		if(data1&0x80) lcd_sid=1;
		else lcd_sid=0;
		lcd_sclk=1;
	 	data1=data1<<=1;
    }
}

/*延时*/
void delay(int n_ms)               
{
 int j,k;
 for(j=0;j<n_ms;j++)
	 for(k=0;k<110;k++);
}


/*等待一个按键，我的主板是用P2.0与GND之间接一个按键*/
void waitkey()
{
 repeat:
  	if (P2&0x01) goto repeat;
	else delay(6);
	if (P2&0x01) goto repeat;
	else
	delay(40);;
}

/*LCD模块初始化*/
void initial_lcd()
{
//		lcd_cs1=0;
      	lcd_reset=0;                /*低电平复位*/
      	delay(20);
      	lcd_reset=1;		        /*复位完毕*/
      	delay(20);          
		transfer_command_lcd(0xe2);	 /*软复位*/
		delay(5);
		transfer_command_lcd(0x2c);  /*升压步聚1*/
		delay(5);	
		transfer_command_lcd(0x2e);  /*升压步聚2*/
		delay(5);
		transfer_command_lcd(0x2f);  /*升压步聚3*/
		delay(5);
		transfer_command_lcd(0x24);  /*粗调对比度，可设置范围0x20～0x27*/
		transfer_command_lcd(0x81);  /*微调对比度*/
		transfer_command_lcd(0x0d);  /*0x1a,微调对比度的值，可设置范围0x00～0x3f*/
		transfer_command_lcd(0xa2);  /*1/9偏压比（bias）*/
		transfer_command_lcd(0xc8);  /*行扫描顺序：从上到下*/
		transfer_command_lcd(0xa0);  /*列扫描顺序：从左到右*/
		transfer_command_lcd(0x40);  /*起始行：第一行开始*/
		transfer_command_lcd(0xaf);  /*开显示*/
//		lcd_cs1=1;



// 	delay(100);	// 以下几行代码是产生硬件复位
//	lcd_reset = 0;
// 	delay(50);	// 
//	lcd_reset = 1;
// 	delay(100);	// 

//	transfer_command_lcd(0xe2);	//soft reset开始进行软复位
// 	delay(10);
//	transfer_command_lcd(0xa2);	//bias select确定为1/9BIAS,1/65duty
// 	delay(2);
//	transfer_command_lcd(0xa0);	// ADC select确定SEG反扫seg0--->seg131
// 	delay(2);
//	transfer_command_lcd(0xc8);	//SHL select确定COM为正扫com63--->com0
// 	delay(2);
//	transfer_command_lcd(0x25);	//regulator resistor select V0调整电阻设定(1 + Rb/Ra)=5.0		0X26+0X41		vdd=5.0v,vop=10.0v						 0x26原来的数值
// 	delay(2);
//	transfer_command_lcd(0x81);	//The Electronic Volume (Double Byte Command)数字电位器调节VO输出电压(也就是对比度)两字节				 0x81原来的数值
//	transfer_command_lcd(25);//vop 设置
// 	delay(2);
//	transfer_command_lcd(0x2c);	//power control1 on内部倍压电路开启,需分以下三步打开电路
// 	delay(2);
//	transfer_command_lcd(0x2e);	//power control2
//	delay(2);
//	transfer_command_lcd(0x2f);	//power control3
// 	delay(2);
//	transfer_command_lcd(0xf1);	//The Booster Ratio (Double Byte Command)设定倍压数,两字节
// 	delay(2);
//	transfer_command_lcd(0x00);	//"00"最大4倍压,"01"最大5倍压,"03"最大6倍压
// 	delay(2);
//	transfer_command_lcd(0x60);	//设定起始行第1行
// 	delay(2);
//	transfer_command_lcd(0xa4);	//Display All Points ON/OFF to Normal display mode正常显示模式选择
// 	delay(2);
//	transfer_command_lcd(0xaf);	//Display ON/OFF开显示设定
// 	delay(2);
}


void lcd_address(uchar page,uchar column) 
{ 
	column=column-1; //我们平所说的第1列，在LCD驱动IC里是第0列。所以在这里减1
	page=page-1; //设置页地址。每页是8行。一个画面的64行被分成8个页。我们平常
//				说的第1页，在LCD驱动IC里是第0页，所以在这里减去1*/ 
	
	transfer_command_lcd(0xb0+page); 
	transfer_command_lcd(((column>>4)&0x0f)+0x10); //设置列地址的高4位 
	transfer_command_lcd(column&0x0f);             //设置列地址的低4位 
} 


/*全屏清屏*/
void clear_screen()
{
	unsigned char i,j;
 	lcd_cs1=0;
 	for(i=0;i<9;i++)
        {
		transfer_command_lcd(0xb0+i);
		transfer_command_lcd(0x10);
		transfer_command_lcd(0x00);
		for(j=0;j<132;j++)
		{
	        	transfer_data_lcd(0x00);
		}
         }
 	lcd_cs1=1;
}
/*显示16x16点阵图像、汉字、生僻字或16x16点阵的其他图标*/
void display_graphic_16x16(uint page,uint column,uchar *dp)
{
	uint i,j;
	uchar page_address;
	uchar column_address_L,column_address_H;
	column=column-1;
	page_address = 0xb0+page-1;
	column_address_L =column&0x0f;
	column_address_H =((column>>4)&0x0f)+0x10;
 	lcd_cs1=0;
	for(j=0;j<2;j++)
	{
		transfer_command_lcd(page_address+j);   /*设置页地址*/
		transfer_command_lcd(column_address_H);	/*设置列地址的高4位*/
		transfer_command_lcd(column_address_L);	/*设置列地址的低4位*/
		for (i=0;i<16;i++)
		{	
			transfer_data_lcd(*dp);					/*写数据到LCD,每写完一个8位的数据后列地址自动加1*/
			dp++;
		}
	}
	lcd_cs1=1;
}


/*显示8x16点阵图像、ASCII, 或8x16点阵的自造字符、其他图标*/
void display_graphic_8x16(uint page,uchar column,uchar *dp)
{
	uint i,j;
	uchar page_address;
	uchar column_address_L,column_address_H;
	lcd_cs1=0;
	column=column-1;
	page_address = 0xb0+page-1;
	column_address_L =column&0x0f;
	column_address_H =((column>>4)&0x0f)+0x10;

	for(j=0;j<2;j++)
	{
		transfer_command_lcd(page_address+j);   /*设置页地址*/
		transfer_command_lcd(column_address_H);	/*设置列地址的高4位*/
		transfer_command_lcd(column_address_L);	/*设置列地址的低4位*/
		for (i=0;i<8;i++)
		{	
			transfer_data_lcd(*dp);					/*写数据到LCD,每写完一个8位的数据后列地址自动加1*/
			dp++;
		}
	}
	lcd_cs1=1;
}


/*显示5*7点阵图像、ASCII, 或5x7点阵的自造字符、其他图标*/
void display_graphic_5x7(uint page,uchar column,uchar *dp)
{
	uint col_cnt;
	uchar page_address;
	uchar column_address_L,column_address_H;
	page_address = 0xb0+page-1;
	column=column-1;	
	lcd_cs1=0;	
	
	column_address_L =column&0x0f;
	column_address_H =((column>>4)&0x0f)+0x10;
	
	transfer_command_lcd(page_address); 		/*Set Page Address*/
	transfer_command_lcd(column_address_H);	/*Set MSB of column Address*/
	transfer_command_lcd(column_address_L);	/*Set LSB of column Address*/
	
	for (col_cnt=0;col_cnt<8;col_cnt++)
	{	
		transfer_data_lcd(*dp);
		dp++;
	}
	lcd_cs1=1;
}

/****液晶屏测试程序：边框测试***/
void display_graphic128x64(char *dp)
{
	unsigned char i,j;
 	lcd_cs1=0;
 	for(i=0;i<9;i++)
   {
		transfer_command_lcd(0xb0+i);
		transfer_command_lcd(0x10);
		transfer_command_lcd(0x00);
		for(j=0;j<128;j++)
		{
	        	transfer_data_lcd(*dp);
				dp++;
		}
   }
 	lcd_cs1=1;

}

/****液晶屏测试程序***/
void test_screen(uchar data1,uchar data2)
{
	unsigned char i,j;
 	lcd_cs1=0;	
 	for(i=0;i<9;i++)
   {
		transfer_command_lcd(0xb0+i);
		transfer_command_lcd(0x10);
		transfer_command_lcd(0x00);
		for(j=0;j<64;j++)
		{
	        	transfer_data_lcd(data1);
	        	transfer_data_lcd(data2);
  		}
   }
 	lcd_cs1=1;
}

//===显示测试画面：例如全显示，隔行显示，隔列显示，雪花显示===== 
void test_display(uchar data1,uchar data2) 
{ 
	int i,j; 
	for(j=0;j<8;j++) 
	 {
	 lcd_address(j+1,0); 
	for(i=0;i<128;i++) 
	  {
	 transfer_data_lcd(data1);    
	 transfer_data_lcd(data2);  
	  }
	 }           
} 

void sleep() 
{ 
	transfer_command_lcd(0xac);/*静态图标关闭*/ 
	transfer_command_lcd(0x00);/*静态图标寄存器设置：关闭。此指令与上述指令一起完成静态图标关闭*/ 
	transfer_command_lcd(0xae);/*显示：关*/ 
	transfer_command_lcd(0xa5);/*全屏显示：开*/ 
} 

void wake() 
{ 
	transfer_command_lcd(0xa4);/*全屏显示：关。进入正常模式*/ 
	transfer_command_lcd(0xad);/*静态图标开启*/ 
	transfer_command_lcd(0x03);/*静态图标寄存器设置：开。此指令与上述指令一起完成静态图标开启*/ 
	transfer_command_lcd(0xaf);/*显示：开*/ 
} 
//===开始 “读取-修改-写入” 模式==== 
void Start_Read_Modify_Write() 
{ 
	transfer_command_lcd(0xe0); 
 
} 
//===结束 “读取-修改-写入” 模式==== 
void End_Read_Modify_Write() 
{ 
	transfer_command_lcd(0xee); 
 
} 
 
//从液晶屏驱动IC中读取数据,含一次空读和一次正式读取 
uchar read_data_twice() 
{ 
 
//	 uchar ret_data=0; 
//	 P1=0xff; 
//	 lcd_cs1=0; 
//	 rs=1; 
//	 rw=1; 
//	 
//	//一次空读---------------- 
//	 e=0; 
//	 e=1;   
//	 delay_us(1); 
//	 
//	//---一次正式读------------ 
//	 e=0;   
//	 e=1;   
//	 delay_us(1); 
//	//------------------------ 
//	 ret_data=P1; 
//	 cs1=1; 
//	 e=0; 
//	 return(ret_data); 


    uchar i, received_data = 0;

    for (i = 0; i < 8; i++)  
    {
        received_data <<= 1;  // 左移，为接收的数据腾出位置
        lcd_sclk = 0;         // 下降沿准备接收数据
        delay(1);  

        if (lcd_sid)          // 读取 SPI 数据引脚
        {
            received_data |= 0x01;  // 置位最低位
        }

        lcd_sclk = 1;  // 上升沿锁存
        delay(1);
    }

    return received_data;
} 
 
//画点函数。括号里的参数分别为：坐标(column,row),row为行,共64行，最小值为1，最大值为64; column为列,共128列,最小值为1，最大值为128. 
void draw_point(uint column,uint row)   
{ 
 uchar i,dat,page; 
 row--;                                                  
 column--;     //我们平常的“第1行”在液晶屏里叫“第0行”，所以减1，同理,列也如此 
 page=row/8; 
 page++; 
 lcd_address(page,column); //设置地址 
 Start_Read_Modify_Write(); //开始 “读取-修改-写入” 模式 
 i=row%8;     //行位置分成了第几页和这一页内的第几位,i=y%8即是这个第几位 
 dat=1; 
 dat<<=i;     //用移位的方法,根据这个“第几位”算出这个字节的数值来，这个就是我们要画的“点”的一个字节数据 
 dat|=read_data_twice();  //要画点的数据和刚读到的原来液晶屏的位置上的数据进行“或”运算，以免覆盖原来的数据。 
 transfer_data_lcd(dat); 
 
 End_Read_Modify_Write(); //结束 “读取-修改-写入” 模式 
} 
	
 
//“画直线”函数的注意事项： 
//直线的斜率k=(y2-y1)/(x2-x1)，k\x1\y1\x2\y2必须是浮点型的数据，除此之外，由于终点坐标可能小于起点坐标，所以斜率
//还有可能是负数的。 
//由于k=(y2-y1)/(x2-x1)，所以在x2=x1时，导致除数为0，数学上这是行不通的，所以另外想办法。同理k_y=(x2-x1)/(y2-y1)
//当y2=y1时也是行不通的。 
//另外int是16位的整数，uchar却只有8位.
//void draw_line(float x1,float y1,float x2, float y2) 
//{ 
// int i;float k,k_y,x,z; 
// if( (y2-y1)==0&&(x2-x1)!=0 ) //如果y2-y1=0且x2-x1不等于0，则画一条横线。 
// { 
//  if(x2<x1)       //如果x2<x1，则两个坐标互换。画横线时，从左到右与从右到左是一样的结果。 
//  { 
//   z=x2; x2=x1;x1=z; 
//  } 
//  for(i=0;i<=(x2-x1);i++) 
//  { 
//   draw_point((x1+i),y1); 
//  } 
// } 
// else if( ((x2-x1)==0)&&((y2-y1)!=0 )) //如果x2-x1=0且y2-y1不等于0，则画一条竖线。 
// { 
//  if(y2<y1)       //如果y2<y1，则两个坐标互换。画竖线时，从上到下与从下到上是一样的结果。 
//  { 
//   z=y2; y2=y1;y1=z; 
//  } 
//  for(i=0;i<=(y2-y1);i++) 
//  { 
//   draw_point(x1,(y1+i)); 
//  } 
// } 
// else if((x2-x1)==0&&(y2-y1)==0)     //如果 (x2=x1)且(y2=y1)，画一个点即可 
// { 
//  draw_point(x1,y2);  
// } 
// 
// else           //否则，画斜线 
// { 
//  if(x2<x1)        //如果x2<x1，则两个坐标互换。（从起点画到终点）与（从终点画到起点）结果是一样的。 
//  { 
//   z=y2; y2=y1;y1=z; 
//   z=x2; x2=x1;x1=z; 
//  } 
//  else;       // 
//          
//  if(fabs(y2-y1)<=fabs(x2-x1)) //如果(y2-y1)的绝对值小于等于（x2-x1）的绝对值，就启动方案一：x逐点扫描，y按斜率计算，然后画点（x+i，y） 
//  { 
//   k=(y2-y1)/(x2-x1);        //k是斜率 
//   for(i=0;i<=(x2-x1);i++) 
//   { 
//    draw_point((x1+i),(y1+k*i)); 
//   } 
// 
//  } 
//  else          //如果(y2-y1)的绝对值大于(x2-x1)的绝对值，就启动方案二：y逐点扫描，x按斜率计算，然后画点（x,y+i）或（x,y-i) 
//  { 
//   k_y=fabs((x2-x1)/(y2-y1)); //k_y是反斜率（即x除以y）。fabs是浮点型数据的绝对值 
//   for(i=0;i<=fabs(y2-y1);i++) 
//   { 
//    x=x1+k_y*i; 
//    if((y2-y1)>0) 
//    { 
//     draw_point(x,(y1+i)); 
//    } 
//    else 
//    { 
//    draw_point(x,(y1-i));

//    }
//   }
//  }
// }
// } 

 
 
 
//===============main program===================
void main(void)
{     
	initial_lcd();
	while(1)
	{
		display_graphic128x64(bmp1);
		waitkey();			
		test_screen(0xff,0xff);
		waitkey();			
		test_screen(0x55,0xaa);
		waitkey();			
		test_screen(0xaa,0x55);
		waitkey();				
	}
}
char code bmp1[]={
/*--  调入了一幅图像：D:\e\新开发部\显示图案收藏\晶联讯LOGO小图黑白-有框.bmp  --*/
/*--  宽度x高度=128x64  --*/
0xFF,0x01,0x01,0x01,0x01,0x01,0x01,0x01,0x01,0x01,0x01,0x01,0x01,0x01,0x01,0x81,
0x81,0x81,0x81,0x81,0xC1,0xC1,0xC1,0xC1,0xC1,0xC1,0xC1,0xC1,0xE1,0xE1,0xE1,0xE1,
0xE1,0xE1,0xE1,0xE1,0xE1,0xE1,0xE1,0xE1,0xE1,0xE1,0xE1,0xE1,0xE1,0xC1,0xC1,0xC1,
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0x87,0x87,0x87,0x87,0x87,0x87,0x87,0x87,0x87,0x87,0x87,0x84,0x80,0x80,0x80,0xFF

};
