//=-=-=-=-=-=-=-=-=-=-=-=-=-=-=-=-=-=-=-=-=-=-=-=-=-=-=-=-=-=-=-=-=-=-=-=-=-=-=-=-=-=-=-=-=-=-=-=-=-=

//=-=-=-=-=-=-=-=-=-=-=-=-=-=-=-=-=-=-=-=-=-=-=-=-=-=-=-=-=-=-=-=-=-=-=-=-=-=-=-=-=-=-=-=-=-=-=-=-=-=

#include <at89C51.h>
#include <intrins.h>



#define Uchar unsigned char
#define Uint  unsigned int
#define Ulong unsigned long
#define uchar unsigned char
#define uint  unsigned int


//-=-=-=-=-=-=-=-=-=-=-=-=-=-=-=-=-=-=-=-=-=-=-=-=-=-=-=-=-=-=-=-=-=-=-=
//  Pin Definition
//-=-=-=-=-=-=-=-=-=-=-=-=-=-=-=-=-=-=-=-=-=-=-=-=-=-=-=-=-=-=-=-=-=-=-=


//0.66bule
#define RES3	P3_0				// Reset   
#define SCL3	P3_1				// Serial Clock Input
#define SDA3	P3_2				// Serial Data Input


//*********************************************************************0.66
code color13[]={
/*--  调入了一幅图像：F:\工作\8051\OLED3\12832\1.bmp  --*/
/*--  宽度x高度=128x32  --*/
0xFF,0x01,0x01,0x01,0x01,0x01,0x01,0x01,0x01,0x01,0x01,0x01,0x01,0x01,0x01,0x01,
0x01,0x01,0x01,0x01,0x01,0x01,0x01,0x01,0x01,0x01,0x01,0x01,0x01,0x01,0x01,0x01,
0x41,0x41,0x41,0xE1,0xF1,0xF1,0x01,0x01,0x01,0x01,0x01,0x01,0x01,0x01,0x01,0x01,
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0x80,0x80,0x80,0x80,0x80,0x80,0x80,0x80,0x80,0x80,0x80,0x80,0x80,0x80,0x80,0xFF
};
code color14[]={/*--  调入了一幅图像：F:\工作\8051\OLED3\12832\中文显示1.bmp  --*/
/*--  宽度x高度=128x32  --*/
0x00,0x20,0xA0,0x78,0x20,0xF8,0x20,0x00,0x00,0x00,0x10,0xF8,0x00,0x00,0x00,0x00,
0xF0,0x08,0x08,0x08,0xF0,0x00,0x00,0x00,0xC0,0xC0,0x00,0x00,0x00,0x00,0xF8,0x88,
0x88,0x88,0xFE,0x88,0x88,0x88,0x88,0xF8,0x00,0x00,0x20,0x10,0xF8,0x06,0x20,0x20,
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0x00,0x08,0x04,0x03,0x00,0x7F,0x00,0x07,0x02,0x00,0x1F,0x08,0x08,0x08,0x1F,0x00
};

//-=-=-=-=-=-=-=-=-=-=-=-=-=-=-=-=-=-=-=-=-=-=-=-=-=-=-=-=-=-=-=-=-=-=-=

void 	delay_ms(Uint t)
{
	Uchar i,j;
	while(--t)
	{
	i=50;	
	j=100;

		while(--j)
			while(--i);
	}
}
void uDelay(Uchar l)
{
	while(l--);
}


void Delay(Uchar n)
{
Uchar i,j,k;

	for(k=0;k<n;k++)
	{
		for(i=0;i<131;i++)
		{
			for(j=0;j<15;j++)
			{
				uDelay(203);	
			}
		}
	}
}



//****************************************************************************
//-=-=-=-=-=-=-=-=-=-=-=-=-=-=-=-=-=-=-=-=-=-=-=-=-=-=-=-=-=-=-=-=-=-=-=
//  Read/Write Sequence
//-=-=-=-=-=-=-=-=-=-=-=-=-=-=-=-=-=-=-=-=-=-=-=-=-=-=-=-=-=-=-=-=-=-=-=
void I2C_3(Uchar mcmd)
{
Uchar length = 8;			// Send Command

	while(length--)
	{
		if(mcmd & 0x80)
		{
			SDA3=1;
		}
		else
		{
			SDA3=0;
		}
//		uDelay(3);
		SCL3=1;
//		uDelay(3);
		SCL3=0;
//		uDelay(3);
		mcmd = mcmd << 1;
	}
}


void I2C_Ack3()
{
	SDA3=1;
//	uDelay(3);
	SCL3=1;
//	uDelay(3);
	SCL3=0;
//	uDelay(3);
}


void I2C_NAck3()
{
	SDA3=0;
//	uDelay(3);
	SCL3=1;
//	uDelay(3);
	SCL3=0;
//	uDelay(3);
}


void I2C_Start3()
{
	SDA3=0;
//	uDelay(3);
	SCL3=1;
//	uDelay(3);
	SCL3=0;
//	uDelay(3);
	I2C_3(0x78);
	I2C_Ack3();
}


void I2C_Stop3()
{
	SCL3=1;
//	uDelay(5);
	SDA3=0;
//	uDelay(5);
	SDA3=1;
//	uDelay(5);
}


void Write_Command3(Uchar Data)
{
	I2C_Start3();
	I2C_3(0x00);
	I2C_Ack3();
	I2C_3(Data);
	I2C_Ack3();
	I2C_Stop3();
}


void Write_Data3(Uchar Data)
{
	I2C_Start3();
	I2C_3(0x40);
	I2C_Ack3();
	I2C_3(Data);
	I2C_Ack3();
	I2C_Stop3();
}
//-=-=-=-=-=-=-=-=-=-=-=-=-=-=-=-=-=-=-=-=-=-=-=-=-=-=-=-=-=-=-=-=-=-=-=

void	LCD_Init3(void)
{
RES3=0;
//uDelay(2);
RES3=1;
//internal setting


Write_Command3(0xae);	//--turn off oled panel

Write_Command3(0x00);	//--set low column address
Write_Command3(0x10);	//--set high column address

Write_Command3(0x00);	//--set start line address

Write_Command3(0xb0);	//--set page address

Write_Command3(0x81);	//--set contrast control register
Write_Command3(0xff);

Write_Command3(0xa1);	//--set segment re-map 127 to 0   a0:0 to seg127
Write_Command3(0xa6);	//--set normal display

Write_Command3(0xc8);	//--set com(N-1)to com0  c0:com0 to com(N-1)

Write_Command3(0xa8);	//--set multiples ratio(1to64)
Write_Command3(0x1f);	//--1/64 duty

Write_Command3(0xd3);	//--set display offset
Write_Command3(0x00);	//--not offset

Write_Command3(0xd5);	//--set display clock divide ratio/oscillator frequency
Write_Command3(0x80);	//--set divide ratio

Write_Command3(0xd9);	//--set pre-charge period
Write_Command3(0x04);

Write_Command3(0xda);	//--set com pins hardware configuration
Write_Command3(0x00);

Write_Command3(0xdb);	//--set vcomh
Write_Command3(0x30);

Write_Command3(0x8d);	//--set chare pump enable/disable
Write_Command3(0x14);	//--set(0x10) disable
//Write_Command3(0x10);	//--set(0x10) disable
Write_Command3(0xaf);	//--turn on oled panel
//-=-=-=-=-=-=-=-=-=-=-=-=-=-=-=-=-=-=-=-=-=-=-=-=-=-=-=-=-=-=-=-=-=-=-=void 	LCD_Init(void)
}


//***********************************************************************
void clr_display3(void)
{
	Uchar i,j;
	for(j=0;j<4;j++)
	{
		Write_Command3(0x22);//--set page1
		Write_Command3(j);//--set start page
		Write_Command3(0x03);//--set end page

 		for(i=0;i<128;i++)		  				//显示单色数据到LCD
		{
			Write_Data3(0x00);
		}
	}
}
			
//-=-=-=-=-=-=-=-=-=-=-=-=-=-=-=-=-=-=-=-=-=-=-=-=-=-=-=-=-=-=-=-=-=-=-=

//-=-=-=-=-=-=-=-=-=-=-=-=-=-=-=-=-=-=-=-=-=-=-=-=-=-=-=-=-=-=-=-=-=-=-=
void pic13(void)
{
	Uchar i,j;
	Uint k;
	k=0;
	for(j=0;j<4;j++)
	{
		Write_Command3(0x22);//--set page1
		Write_Command3(j);//--set start page
		Write_Command3(0x03);//--set end page

 		for(i=0;i<128;i++)		  				//显示单色数据到LCD
		{
			Write_Data3(color13[k]);
			k=k+1;
		
		}
	}
}


void pic14(void)
{
	Uchar i,j;
	Uint k;
	k=0;
	for(j=0;j<4;j++)
	{
		Write_Command3(0x22);//--set page1
		Write_Command3(j);//--set start page
		Write_Command3(0x03);//--set end page

 		for(i=0;i<128;i++)		  				//显示单色数据到LCD
		{
			Write_Data3(color14[k]);
			k=k+1;
		
		}
	}
}
			
//-=-=-=-=-=-=-=-=-=-=-=-=-=-=-=-=-=-=-=-=-=-=-=-=-=-=-=-=-=-=-=-=-=-=-=

//-=-=-=-=-=-=-=-=-=-=-=-=-=-=-=-=-=-=-=-=-=-=-=-=-=-=-=-=-=-=-=-=-=-=-=
void main()
{

	LCD_Init3();

	while(1)

	{   
		pic13();
		delay_ms(10);
		pic14();
		delay_ms(10);

	}
}
