//GM19264-05
//IC:UC1609
//-SPI
#include <reg52.h>
#include <intrins.h>

sbit CS =P3^4;
sbit RST =P3^2;
sbit CD= P3^3;
sbit SCK =P3^0;
sbit SDA= P3^1;

#define Uchar unsigned char
#define Uint  unsigned int
#define somenop();_nop_();_nop_();_nop_();_nop_();

Uchar code clear[]={0x00,0x00,0x00,0x00};
Uchar code black[]={0xff,0xff,0xff,0xff};

Uchar code pic1[];


Uchar code IC[]={

0xe2,//system reset

0xa0,//set Frame Rate[A0: 76fps, A1b: 95fps, A2b: 132fps, A3b: 168fps(fps: frame-per-second)] 
 
0xeb,//set BR 
0x2f,//set Power Control

0xc2,//set LCD Mapping Control
0x81,//set PM
160, //set PM 110
0xaf,//display Enable
                 };
//----------------------------------------------------------
void Delay(Uint times)
  {
   while(times)
   {
    times--;
   }
  }
//----------------------------------------------------------
void M_Delay(Uint NOs)
  {
   while(NOs)
   {
    Delay(50);
    NOs--;
   }
  }

void WriteData(Uchar data1, bit di)
{
       Uchar i,temp;
        CS=0;
		CD=di;
		for(i=0;i<8;i++)
		    {
                  SCK=0;
		  temp=data1;
		  SDA=(bit)(temp&0x80);

		  somenop();
	      SCK=1;
          temp=data1<<1;
	      data1=temp;
 		     }
        CS=1;
		CD=~di;
}

//----------------------------------------------------------
void Init_lcd(void)
  {
   int i;
   RST=0;
   Delay(200);
   RST=1;
   Delay(50000);
   for(i=0;i<8;i++)
   {
    WriteData(IC[i],0);
   }
  }

//----------------------------------------------------------
void Displine(Uchar array[])
  {
   Uint i,j,k;
   for(i=0;i<9;i++)
   {

    WriteData(0x40,0);  //set scroll line
    WriteData(0xb0|i,0);//set page address
    WriteData(0x10,0);  //column  msb
    WriteData(0x00,0);  //column  lsb
    for(j=0;j<48;j++)
    for(k=0;k<4;k++)
    {
     WriteData(array[k],1);
    }
   }
  }

//----------------------------------------------------------

void Dispgraphic(Uchar *p)
    {
	   Uchar i,j;

		   for(i=0;i<8;i++)
		   {
			    WriteData(0x40,0);
			    WriteData(0xb0|i,0);
			    WriteData(0x10,0);
			    WriteData(0x00,0);
			    for(j=0;j<192;j++)
				    {
				     WriteData(p[i*192+j],1);
			         }
           }

  }
 void main(void)
  {
   Init_lcd();
   Displine(clear);
   while(1)

   {

	Displine(black);
	M_Delay(1500);

	Dispgraphic(pic1);
	M_Delay(1500);
   }
  }

Uchar code pic1[]={
//--  调入了一幅图像：19264GYC_LOGO.bmp  --
//--  宽度x高度=192x64  --
//内容："金逸晨电子有限公司GoldenMorning Electronic CO.,LTD/LCD192X64 UC1609 SPI"

0xFF,0x01,0x01,0x01,0x01,0x01,0x01,0x01,0x01,0x01,0x01,0x01,0x01,0x01,0x01,0x01,
0x01,0x01,0x01,0x01,0x01,0x01,0x01,0x01,0x01,0x01,0x01,0x01,0x01,0x01,0x01,0x01,
0x01,0x01,0x01,0x01,0x01,0x01,0x01,0x01,0x01,0x01,0x01,0x01,0x01,0x01,0x01,0x01,
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0x80,0x80,0x80,0x80,0x80,0x80,0x80,0x80,0x80,0x80,0x80,0x80,0x80,0x80,0x80,0xFF,
};
