//----------------------------------------------------------------------
// Module    	: 	ERC12864-6 Series
// Create    	: 	JAVEN LIU
// Date      	: 	2023-05-29
// Drive IC  	: 	ST7567
// INTERFACE 	: 	4 LINE SPI
// MCU 	 		: 	ST12LE5A60S2
// VDD		 	: 	3.3V       
//----------------------------------------------------------------------

#include <AT89X52.H>
#include <intrins.h>

#define uint unsigned int
#define uchar unsigned char

//LCD IO		
#define RS                     P3_2
#define CS1                    P3_0
#define RST                    P3_1
sbit SDA=P3^4;
sbit SCK=P3^3;

//KEY Adjust contrast
//sbit key_add=P2^1;
//sbit key_dec=P2^2;
//sbit pause=P2^0;
bit log=0;


//ERC12864SBS-6  ERC12864FS-6 :29 
uchar Contrast=29;  

//ERC12864SS-6  ERC12864SG-6:	36
//uchar Contrast=36; 

//Resolution
uchar	 SIZE;
#define Max_Column	128
#define Max_Row		64



void Delay(uint n);
void delay_ms(uint Delay);
void display_Contrast(uchar number);
void adj_Contrast(void);
	
void Set_Contrast_Control_Register(unsigned char mod);
void Set_Column_Address(unsigned char add);
void Set_Page_Address(unsigned char add);
void Write_Data(unsigned char dat);
void Write_Instruction(unsigned char cmd);
void Initial(void);	
void ClearScreen(void);
void ShowChar(unsigned char x,unsigned char y,unsigned char chr);
void ShowNum(unsigned char x,unsigned char y,unsigned int  num,unsigned char len,unsigned char size2);
void ShowString(unsigned char x,unsigned char y, unsigned char *p);	 
void Set_Pos(unsigned char x, unsigned char y);
void ShowCHinese(unsigned char x,unsigned char y,unsigned char no);
void DrawBMP(unsigned char x0, unsigned char y0,unsigned char x1, unsigned char y1,unsigned char BMP[]);												 
void Show_line_dot();
void Show(unsigned char d1,unsigned char d2);


const unsigned char code  F6x8[][6];
const unsigned char code F8X16[];
unsigned char code Hzk[];
unsigned char code pic1[];
unsigned char code pic2[];
unsigned char code pic3[];
unsigned char code pic4[];





void main(void)
{   
	P0=0xff; P1=0xff;P2=0xff;P3=0xff;

	IE=0x81;
	IP=0x01;
	TCON=0x01;

	delay_ms(100);
    Initial();

	while(1)
	{
		ClearScreen();
		
		ShowCHinese(32, 0,0);
		ShowCHinese(48,0,1);
		ShowCHinese(64,0,2);
		ShowCHinese(80,0,3);		
		ShowCHinese(96,0,4);
		
		ShowCHinese(32, 2,5);  
		ShowCHinese(48,2,6); 
 		ShowCHinese(64,2,7); 
		ShowCHinese(80,2,8);	
		ShowCHinese(96,2,9);  		 

		SIZE=8;
		ShowString(23,4,"Intelligent");
		SIZE=8;
	 	ShowString(9,5,"Optoelectronic s");
		SIZE=8;
	 	ShowString(30,6,"Co.,Ltd.");  
	
		delay_ms(150);
	
	   	ClearScreen();

		DrawBMP(1,0,128,8,pic1); //x:0,y:0,col:128,line:8*8=64 	 
		delay_ms(60);
//	    Write_Instruction(0xa7);  //Set  inverse  display 	 
//    	delay_ms(60);
//	    Write_Instruction(0xa6);  //Set normal display 
//		delay_ms(6); 

		ClearScreen();

  		Show_line_dot();

	}
}






void Delay(uint n)
{ unsigned int i;
while(n--)
  {  
   for(i=0;i<400;i++) 
     {;} 

   }
}


void delay_ms(uint Delay)
{unsigned int i; 
while(Delay)
  {
   for(;Delay>0;Delay--) 
   {  
    for(i=0;i<1000;i++) 
        {;}   
 //   if((key_add==0)||(key_dec==0)) adj_Contrast();	     			
   }
  
	for(;log==1;);
  }

	return;
}




void Step(void) interrupt 0 using 0
{  ET0=0;
 // Delay(3);
//	if(pause==0)
	log=!log;

 //  while(!pause);
     ET0=1;
  return;

}




void display_Contrast(uchar number)
{	uchar number1,number2;	uchar value[10] = {'0', '1', '2', '3', '4', '5', '6', '7', '8', '9'};
	number1=number/10;number2=number%10;
	ShowChar(0,0,value[number1]) ;
	ShowChar(6,0,value[number2]) ;

}



void adj_Contrast(void)
{	
 //	 if((key_add==0)||(key_dec==0))
		{		
//		 if	(key_add==0) 
			{
			Contrast+=1;if(Contrast>0x3f)(Contrast=0);
		   	Set_Contrast_Control_Register(Contrast);	
			display_Contrast(Contrast);
			Delay(300);
	//		if(key_add==0)
				{Delay(300);
	//				if(key_add==0)			
						{Delay(300);
	//						if(key_add==0)
								{Delay(300);
	//								if(key_add==0)

	//									{while(key_add==0)
											{
											Contrast+=1; if(Contrast>0x3f)(Contrast=0);
		   										Set_Contrast_Control_Register(Contrast);	
												display_Contrast(Contrast);
							 					Delay(300); 
											}
										}
								}				
						}						
				}												
			}
	


		  
	
	//	 if	(key_dec==0) 
			{
			Contrast-=1; if((Contrast<=0xff)&&(Contrast>0x3f))(Contrast=0x3f);
		   	Set_Contrast_Control_Register(Contrast);	
			display_Contrast(Contrast);
			Delay(300);
	//		if(key_dec==0)
				{Delay(300);
	//				if(key_dec==0)			
						{Delay(300);
	//						if(key_dec==0)
								{Delay(300);
//									if(key_dec==0)

//										{while(key_dec==0)
											{
//											Contrast-=1; if((Contrast<=0xff)&&(Contrast>0x3f))(Contrast=0x3f);
//		   										Set_Contrast_Control_Register(Contrast);	
//												display_Contrast(Contrast);
//							 					Delay(300); 
											}
										}
								}				
						}						
				}												
			}










#pragma disable 
void Write_Data(unsigned char dat)
{
    unsigned char idata i;
    RS=1;
	SCK=0;
	CS1=0;
	for(i=0;i<8;i++)
	{
	    SCK=0;
		_nop_();
		_nop_();
		SDA=dat&0x80;
		dat=dat<<1;
		_nop_();
		_nop_();
		SCK=1;
		_nop_();
		_nop_();
	}
	CS1=1;
	return;
}



#pragma disable
void Write_Instruction(unsigned char cmd)
{
    unsigned char idata i;
    RS=0;
	SCK=0;
	CS1=0;
	for(i=0;i<8;i++)
	{
	    SCK=0;
		_nop_();
		_nop_();
		SDA=cmd&0x80;
		cmd=cmd<<1;
		_nop_();
		_nop_();
		SCK=1;
		_nop_();
		_nop_();
	}
	CS1=1;
	return;
}




#pragma disable
void Initial(void)
{

	RST=1;
	delay_ms(10);
	RST=0;
	delay_ms(10);
	RST=1;
	delay_ms(10);

      
	Write_Instruction(0xe2);//soft reset	 
	delay_ms(10);
	Write_Instruction(0x2c);  	//Control built-in power circuit ON	    VB
	Write_Instruction(0x2e);  	//Control built-in power circuit ON	    VR 
	Write_Instruction(0x2f);  	//Control built-in power circuit ON	    VF 
	delay_ms(10);

	Write_Instruction(0xf8);  //Set booster level
 	Write_Instruction(0x00);  //Set  4X booster level

	Write_Instruction(0x25);  //Select regulation resistor ratio
	Write_Instruction(0x81);  	 //Setelectronic volume (EV) level 
	Write_Instruction(Contrast);  //Setelectronic volume (EV) level 
	Write_Instruction(0xa2);  //1/9bias 
	Write_Instruction(0xc8);  //Set output direction of COM 
	Write_Instruction(0xa1);  //Set scan direction of SEG 
 	Write_Instruction(0xa4);  //Set normal display 

  	Write_Instruction(0xa6);  //Set normal display 

	Write_Instruction(0x40);  //start line
	Write_Instruction(0xaf);  //  display ON 


}


void Set_Contrast_Control_Register(unsigned char mod)
{
    Write_Instruction(0x81);
	Write_Instruction(mod);
	return;
}


// Set page address 0~8
void Set_Page_Address(unsigned char add)
{
    add=0xb0|add;
    Write_Instruction(add);
	return;
}

void Set_Column_Address(unsigned char add)
{
    Write_Instruction((0x10|(add>>4)));
	Write_Instruction((0x0f&add));
	return;
}



void Set_Pos(unsigned char x, unsigned char y) 
{ 
	Write_Instruction(0xb0+y);
	Write_Instruction(((x&0xf0)>>4)|0x10);
	Write_Instruction((x&0x0f)); 
} 


				 
// ShowChar   size: 16/8 
void ShowChar(unsigned char x,unsigned char y,unsigned char chr)
{      	
	unsigned char c=0,i=0;	
		c=chr-' ';			
		if(x>Max_Column-1){x=0;if(SIZE==16)y+=2;else y+=1;}
		if(SIZE ==16)
			{
			Set_Pos(x,y);	
			for(i=0;i<8;i++)
			Write_Data(F8X16[c*16+i]);
			Set_Pos(x,y+1);
			for(i=0;i<8;i++)
			Write_Data(F8X16[c*16+i+8]);
			}
			else {	
				Set_Pos(x,y);
				for(i=0;i<6;i++)
				Write_Data(F6x8[c][i]);
				
			}
}



//m^n函数
unsigned int pow(unsigned char m,unsigned char n)
{
	unsigned int result=1;	 
	while(n--)result*=m;    
	return result;
}				  
//Show  number	 		  
void ShowNum(unsigned char x,unsigned char y,unsigned int num,unsigned char len,unsigned char size2)
{         	
	unsigned char t,temp;
	unsigned char enshow=0;						   
	for(t=0;t<len;t++)
	{
		temp=(num/pow(10,len-t-1))%10;
		if(enshow==0&&t<(len-1))
		{
			if(temp==0)
			{
				ShowChar(x+(size2/2)*t,y,' ');
				continue;
			}else enshow=1; 
		 	 
		}
	 	ShowChar(x+(size2/2)*t,y,temp+'0'); 
	}
} 
//ShowString
void ShowString(unsigned char x,unsigned char y,unsigned char *chr)
{
	unsigned char j=0;
	while (chr[j]!='\0')
	{		ShowChar(x,y,chr[j]);
			x+=8;
		if(x>120){x=0; if(SIZE==16)y+=2;else y+=1;}
			j++;
	}
}
//ShowCHinese
void ShowCHinese(unsigned char x,unsigned char y,unsigned char no)
{      			    
	unsigned char t;
	Set_Pos(x,y);	
    for(t=0;t<16;t++)
		{
				Write_Data(Hzk[32*no+t]);
			
        }	
		Set_Pos(x,y+1);	
    for(t=16;t<32;t++)
		{	
				Write_Data(Hzk[32*no+t]);
			
        }					
}

void DrawBMP(unsigned char x0, unsigned char y0,unsigned char x1, unsigned char y1,unsigned char BMP[])
{ 	
 unsigned int j=0;
 unsigned char x,y;
  
  if(y1%8==0) y=y1/8;      
  else y=y1/8+1;
	for(y=y0;y<y1;y++)
	{
		Set_Pos(x0,y);
    for(x=x0;x<x1;x++)
	    {      
	    	Write_Data(BMP[j++]);	    	
	    }
	}
} 



void ClearScreen(void)
{
    unsigned char i,j;
	for(i=0;i<8;i++)
	{
	Set_Page_Address(i);
    Set_Column_Address(0x00);
        for(j=0;j<132;j++)
		{
		    Write_Data(0x00);
		}
	}
    return;
}

void Show(unsigned char d1,unsigned char d2)
{
    unsigned char i,j;
	for(i=0;i<8;i++)
	{
	Set_Page_Address(i);
    Set_Column_Address(0x00);
        for(j=0;j<66;j++)
		{
		    Write_Data(d1);
			Write_Data(d2);
		}
	}
    return;
}


void Show_line_dot()
{
   Show(0x55,0xaa);
 	delay_ms(100);
   Show(0xaa,0x55);
 	delay_ms(100);

   Show(0x55,0x55);
 	delay_ms(100);
   Show(0xaa,0xaa);
 	delay_ms(100);

   Show(0xff,0x00);
 	delay_ms(100);
   Show(0x00,0xff);
 	delay_ms(100);

    return;
}




//ASCII
//大小:6*8
/************************************6*8************************************/
const unsigned char code F6x8[][6] =		
{
0x00, 0x00, 0x00, 0x00, 0x00, 0x00,// sp
0x00, 0x00, 0x00, 0x2f, 0x00, 0x00,// !
0x00, 0x00, 0x07, 0x00, 0x07, 0x00,// "
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0x14, 0x14, 0x14, 0x14, 0x14, 0x14,// horiz lines
};
/****************************************8*16的************************************/
const unsigned char code F8X16[]=	  
{
  0x00,0x00,0x00,0x00,0x00,0x00,0x00,0x00,0x00,0x00,0x00,0x00,0x00,0x00,0x00,0x00,// 0
  0x00,0x00,0x00,0xF8,0x00,0x00,0x00,0x00,0x00,0x00,0x00,0x33,0x30,0x00,0x00,0x00,//! 1
  0x00,0x10,0x0C,0x06,0x10,0x0C,0x06,0x00,0x00,0x00,0x00,0x00,0x00,0x00,0x00,0x00,//" 2
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  0x00,0x06,0x01,0x01,0x02,0x02,0x04,0x04,0x00,0x00,0x00,0x00,0x00,0x00,0x00,0x00,//~ 94
};
unsigned char code Hzk[]={

/* [字库]：[HZK1616宋体] [数据排列]:从左到右从上到下 [取模方式]:纵向8点下高位 [正负反色]:否 [去掉重复后]共10个字符
[总字符库]："智力光电股份有限公司"*/

/*-- ID:0,字符:"智",ASCII编码:D6C7,对应字:宽x高=16x16,画布:宽W=16 高H=16,共32字节*/
0x20,0x28,0x27,0xe4,0x3c,0xa4,0x26,0x24,0x20,0xfc,0x84,0x84,0x84,0xfe,0x04,0x00,
0x04,0x02,0x01,0xfc,0x54,0x54,0x57,0x54,0x54,0x55,0x54,0xfe,0x04,0x01,0x00,0x00,

/*-- ID:1,字符:"力",ASCII编码:C1A6,对应字:宽x高=16x16,画布:宽W=16 高H=16,共32字节*/
0x00,0x10,0x10,0x10,0x10,0x10,0xff,0x10,0x10,0x10,0x10,0x10,0xf8,0x10,0x00,0x00,
0x00,0x80,0x80,0x80,0x60,0x18,0x07,0x00,0x20,0x40,0x80,0x40,0x3f,0x00,0x00,0x00,

/*-- ID:2,字符:"光",ASCII编码:B9E2,对应字:宽x高=16x16,画布:宽W=16 高H=16,共32字节*/
0x40,0x40,0x42,0x44,0x58,0xc0,0x40,0x7f,0x40,0xc0,0x50,0x48,0x46,0x64,0x40,0x00,
0x00,0x80,0x40,0x20,0x18,0x07,0x00,0x00,0x00,0x3f,0x40,0x40,0x40,0x40,0x70,0x00,

/*-- ID:3,字符:"电",ASCII编码:B5E7,对应字:宽x高=16x16,画布:宽W=16 高H=16,共32字节*/
0x00,0xf8,0x48,0x48,0x48,0x48,0xff,0x48,0x48,0x48,0x48,0xfc,0x08,0x00,0x00,0x00,
0x00,0x07,0x02,0x02,0x02,0x02,0x3f,0x42,0x42,0x42,0x42,0x47,0x40,0x70,0x00,0x00,

/*-- ID:4,字符:"股",ASCII编码:B9C9,对应字:宽x高=16x16,画布:宽W=16 高H=16,共32字节*/
0x00,0x00,0xfe,0x22,0x22,0xff,0x42,0xa0,0x9e,0x82,0x82,0x82,0xbf,0xa2,0x20,0x00,
0x80,0x40,0x3f,0x02,0x42,0xff,0x80,0x40,0x43,0x2c,0x18,0x28,0x46,0xc1,0x40,0x00,

/*-- ID:5,字符:"份",ASCII编码:B7DD,对应字:宽x高=16x16,画布:宽W=16 高H=16,共32字节*/
0x80,0x40,0x20,0xf8,0x87,0x40,0xb0,0x8e,0x80,0x80,0x87,0x98,0x20,0x60,0x20,0x00,
0x00,0x00,0x00,0xff,0x00,0x40,0x30,0x0f,0x40,0x80,0x40,0x3f,0x00,0x00,0x00,0x00,

/*-- ID:6,字符:"有",ASCII编码:D3D0,对应字:宽x高=16x16,画布:宽W=16 高H=16,共32字节*/
0x04,0x04,0x04,0x84,0xe4,0x3c,0x27,0x24,0x24,0x24,0x24,0xf4,0x24,0x06,0x04,0x00,
0x04,0x02,0x01,0x00,0xff,0x09,0x09,0x09,0x09,0x49,0x89,0x7f,0x00,0x00,0x00,0x00,

/*-- ID:7,字符:"限",ASCII编码:CFDE,对应字:宽x高=16x16,画布:宽W=16 高H=16,共32字节*/
0x00,0xfe,0x02,0x22,0xda,0x06,0x00,0xfe,0x92,0x92,0x92,0x92,0xff,0x02,0x00,0x00,
0x00,0xff,0x08,0x10,0x08,0x07,0x00,0xff,0x42,0x24,0x08,0x14,0x22,0x61,0x20,0x00,

/*-- ID:8,字符:"公",ASCII编码:B9AB,对应字:宽x高=16x16,画布:宽W=16 高H=16,共32字节*/
0x00,0x00,0x80,0x40,0x30,0x0c,0x00,0xc0,0x06,0x18,0x20,0x40,0x80,0x80,0x80,0x00,
0x01,0x01,0x00,0x30,0x28,0x24,0x23,0x20,0x20,0x28,0x30,0x60,0x00,0x01,0x00,0x00,

/*-- ID:9,字符:"司",ASCII编码:CBBE,对应字:宽x高=16x16,画布:宽W=16 高H=16,共32字节*/
0x10,0x10,0x92,0x92,0x92,0x92,0x92,0x92,0xd2,0x9a,0x12,0x02,0xff,0x02,0x00,0x00,
0x00,0x00,0x3f,0x10,0x10,0x10,0x10,0x10,0x3f,0x00,0x40,0x80,0x7f,0x00,0x00,0x00


};


unsigned char code pic1[]=
{   
	0x00,0x03,0x05,0x09,0x11,0xFF,0x11,0x89,0x05,0xC3,0x00,0xE0,0x00,0xF0,0x00,0xF8,
	0x00,0x00,0x00,0x00,0x00,0x00,0x00,0x44,0x28,0xFF,0x11,0xAA,0x44,0x00,0x00,0x00,
	0x00,0x00,0x00,0x00,0x00,0x00,0x00,0x00,0x00,0x00,0x00,0x00,0x00,0x00,0x00,0x00,
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	0x00,0x00,0x26,0x49,0x49,0x49,0x32,0x00,0x00,0x7F,0x02,0x04,0x08,0x10,0x7F,0x00,/********************************/
};


unsigned char code pic3[]=
{/*--128642.bmp  --*/
/*-- 128x64  --*/
0xFF,0x01,0x01,0x01,0x01,0x01,0x01,0xC1,0xF1,0xFD,0xFD,0x81,0x01,0x01,0x01,0x01,
0x01,0x01,0x01,0x01,0xC1,0xE1,0xF1,0xF9,0xF9,0xFD,0xFD,0xF9,0xF9,0x61,0xF1,0x51,
0x01,0x09,0x0D,0x0D,0x05,0x09,0x09,0x09,0x09,0x09,0x09,0x99,0xB9,0xC1,0x01,0x01,
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0x80,0x9F,0x9F,0x80,0x80,0x9F,0x9F,0x80,0x80,0x9F,0x9F,0x80,0x80,0x80,0x80,0xFF,
};

unsigned char code pic4[]=
{/*--  12864a.bmp  --*/
/*--  128x64  --*/
0x00,0x00,0x00,0x00,0x00,0xC0,0x00,0xE0,0x00,0xF0,0x00,0xFC,0x00,0x00,0x00,0x00,
0x04,0x06,0x12,0x12,0xFE,0xEC,0x00,0xF8,0xFC,0x06,0x02,0x22,0xE6,0xE4,0x00,0x00,
0x00,0x00,0x00,0x00,0x00,0x00,0xF0,0x90,0x9C,0x04,0xF4,0x04,0xF4,0xF4,0x04,0xF4,
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0x00,0x00,0x00,0x00,0x00,0x00,0x00,0x00,0x00,0x00,0x00,0x00,0x00,0x00,0x00,0x00,
};


