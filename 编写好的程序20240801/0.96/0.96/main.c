//Modle :0.96 
//Driver IC:
//Interfaces:SPI-4
#include<reg51.h>
#include<intrins.h>
//#define DATAPORT P1

sbit _CS=P3^4;
//sbit _CS1=P2^1;
sbit RES=P3^3;
sbit RS=P3^2;
sbit SCL=P3^0;/*serial clock input(D6)*/
sbit SI=P3^1;/*serial data input(D7)*/

unsigned char code initial_tab[23]={
0xae,
0x40,
0x20,
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0xAF,
         };

/*unsigned char code test_tab[16]={
                               0xff,0xff,0x00,0x00,
                               0xaa,0xaa,0x55,0x55,
			  	               0xff,0x00,0x00,0xff,
				               0xaa,0x55,0x55,0xaa};*/

unsigned char code picture_tab[]={
/*------------------------------------------------------------------------------
;  源文件 / 文字 : C:\Documents and Settings\Administrator\桌面\新建文件夹 (2)\logo.bmp字模
;  宽×高（像素）: 128×64
------------------------------------------------------------------------------*/
//0x80,0x40,0x10,//宽的像素数,高的像素数，宽的字节数，参数设置可选
	0x00,0x03,0x05,0x09,0x11,0xFF,0x11,0x89,0x05,0xC3,0x00,0xE0,0x00,0xF0,0x00,0xF8,
	0x00,0x00,0x00,0x00,0x00,0x00,0x00,0x44,0x28,0xFF,0x11,0xAA,0x44,0x00,0x00,0x00,
	0x00,0x00,0x00,0x00,0x00,0x00,0x00,0x00,0x00,0x00,0x00,0x00,0x00,0x00,0x00,0x00,
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	0x00,0x00,0x26,0x49,0x49,0x49,0x32,0x00,0x00,0x7F,0x02,0x04,0x08,0x10,0x7F,0x00,
};


void Delay(unsigned int time)
        {
		  unsigned int i,j;
		  for(i=0;i<time;i++)
		     for(j=0;j<20000;j++)
			       {;}
		}
void Ins_trans(unsigned char command)
  { 
    unsigned char counter;
	  _CS=0;
	  RS=0;
    for(counter=0;counter<8;counter++)
       { 
	     SCL=0;
         SI=(command&0x80)>>7;
         command=command<<1;
	       _nop_();
		     SCL=1;
	     //  _nop_();
		     _nop_();
		     SCL=0;
        }
	RS=1;
   _CS=1;
  }
void Data_trans(unsigned char command)
  { 
    unsigned char counter;
	  _CS=0;
	  RS=1;
    for(counter=0;counter<8;counter++)
       {
         SCL=0;
	     SI=(command&0x80)>>7;
		 command=command<<1;   
	       _nop_();
		     SCL=1;
	      // _nop_();
		     _nop_();
		     SCL=0;
       }
	RS=1;
   _CS=1;
   }
void Column_set(unsigned char column)
          {
		     Ins_trans(0x10|(column>>4));
		     Ins_trans(0x00|(column&0x0f));	 
		  }
void Page_set(unsigned char page)
          {
		    Ins_trans(0xb0+page);
		  }
void Screen_clear()
       {
	     unsigned char page,column;
 		  for(page=0;page<8;page++)             //page loop
		     { 
			   Page_set(page);
			   Column_set(0);	  
			   for(column=0;column<128;column++)	//column loop
			      {
				     Data_trans(0x00);
				    }
			   }
	     }
void Screen_check()
       {
	     unsigned char page,column;
 		  for(page=0;page<8;page++)             //page loop
		     { 
			   Page_set(page);
			   Column_set(0);	  
			   for(column=0;column<128;column++)	//column loop
			      {
				     Data_trans(0xff);
				    }
			   }
	     }
void Initial()
          {
		    unsigned char i;
			for(i=0;i<23;i++)
			   {
			     Ins_trans(initial_tab[i]);
			   }
		  }

void Picture_display(unsigned char *ptr_pic)
        {
		  unsigned char page,column;
		  //Ins_trans(0x81);
		  //Ins_trans(0x1F);
 		  for(page=0;page<(64/8);page++)        //page loop
		     { 
			   Page_set(page);
			   Column_set(0);	  
			   for(column=0;column<128;column++)	//column loop
			      {
				     Data_trans(*ptr_pic++);
				  }
			 }
		  Delay(15);
		}

void main()
     { 
		  RES=0;
		  Delay(10);
		  RES=1;
		  Initial();
		  while(1)
		     {
                Screen_clear();
				Screen_check();
                Delay(10);
			    Picture_display(picture_tab);

			 }
	 }


